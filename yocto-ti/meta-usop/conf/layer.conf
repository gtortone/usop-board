## yocto-ti/meta-usop/conf/layer.conf
```bitbake
# We have a conf and classes directory, add to BBPATH
BBPATH .= ":${LAYERDIR}"

# We have recipes-* directories, add to BBFILES
BBFILES += "${LAYERDIR}/recipes-*/*/*.bb \
            ${LAYERDIR}/recipes-*/*/*.bbappend"

BBFILE_COLLECTIONS += "meta-usop"
BBFILE_PATTERN_meta-usop = "^${LAYERDIR}/"
BBFILE_PRIORITY_meta-usop = "20"

LAYERDEPENDS_meta-usop = "core"
LAYERSERIES_COMPAT_meta-usop = "scarthgap"
```

## yocto-ti/meta-usop/conf/machine/usop.conf
```bitbake
# keep the original machine as an override with high prio
MACHINEOVERRIDES =. "beaglebone:"

require conf/machine/beaglebone.conf

MACHINE_PREFIX_usop= "beaglebone"

SERIAL_CONSOLES = "115200;ttyS0"
```
